## src/components/EPD/Kconfig.projbuild
```kconfig
menu "Smart Paper -- E-Paper Display"

choice
    prompt "Select E-Paper Display"
    default EPD_GDEY075T7

config EPD_GDEY042T81
    bool "GDEY042T81/SSD1683 - (4.2\" 400*300)"

config EPD_GDEY075T7
    bool "GDEY075T7/UC8179 - (7.5\" 800*480)"

config EPD_WS073F
    bool "WS073F - (7.3\" 800*480) - 7 colors"

endchoice

endmenu
```

## src/components/UI/Kconfig.projbuild
```kconfig
menu "Smart Paper -- Widgets"

    config WIDGET_STATUS_BAR
        bool "Enable Status Bar Widget"
        default y

    config WIDGET_SENSOR_BME680
        bool "Enable Sensor BME680 Widget"
        default y

    config WIDGET_NETWORK_SIGNAL
        bool "Enable Network Signal Widget"
        default y

endmenu
```

## src/components/data_providers/Kconfig.projbuild
```kconfig
menu "EKOS -- Data Providers"

    config PROVIDER_BATTERY
        bool "Enable Battery ADC Provider"
        default y
        help
            Reads battery voltage via ADC1_CH0 (GPIO1).
            Voltage divider: 680kΩ/150kΩ, LiPo 1S (3.0V–4.2V).
            Exposes: battery_pct (float), battery_voltage (float).

    config PROVIDER_BME280
        bool "Enable BME280 Provider (I2C)"
        default n
        help
            Bosch BME280 environmental sensor via I2C (GPIO14/GPIO21).
            Exposes: temperature (float), humidity (float),
                     pressure (float).

    config PROVIDER_BME680
        bool "Enable BME680 Provider (I2C)"
        default n
        help
            Bosch BME680 environmental sensor via I2C (GPIO14/GPIO21).
            Exposes: temperature (float), humidity (float),
                     pressure (float), gas_resistance (float).

    if PROVIDER_BME680
        config PROVIDER_BME680_HEATER_TEMP
            int "BME680 heater target temperature (°C)"
            default 320
            range 200 400
            help
                Target heater temperature in degrees Celsius for gas measurement.
                Typical value: 320°C. Higher values increase sensitivity but
                also power consumption and sensor wear.

        config PROVIDER_BME680_HEATER_DUR
            int "BME680 heater duration (ms)"
            default 150
            range 1 4032
            help
                Heater on-time in milliseconds for each gas measurement.
                Typical value: 150ms. Longer durations improve stability
                but increase measurement time and power consumption.
    endif

endmenu
```

## src/components/touch_gt911/Kconfig.projbuild
```kconfig
menu "Smart Paper -- Touch Controller"

config USE_GT911
    bool "Enable GT911 touch controller"
    default y
    help
        Enable support for the GT911 capacitive touch controller.

endmenu
```

## src/components/widgets/Kconfig.projbuild
```kconfig
menu "EKOS -- Widgets"

    config WIDGET_DAY_WEATHER
        bool "Enable Day Weather Widget"
        default y

    config WIDGET_FOOBAR
        bool "Enable Foobar Widget"
        default y

    config WIDGET_SIMPLE_DATE
        bool "Enable Simple Date Widget"
        default y

    config WIDGET_BATTERY_DISPLAY
        bool "Enable Battery Display Widget"
        default y

    config WIDGET_STOCK_CHART
        bool "Enable Stock Chart Widget"
        default y

    config WIDGET_SEEDBOX_MONITORING
        bool "Enable Seedbox Monitoring Widget"
        default y

    config WIDGET_SIDE_BAR
        bool "Enable Side Bar Widget"
        default y

    config WIDGET_APPLE_CALENDAR
        bool "Enable Apple Calendar Widget"
        default y

endmenu
```
